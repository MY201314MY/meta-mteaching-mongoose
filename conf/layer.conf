## conf/layer.conf
```bitbake
# We have a conf and classes directory, add to BBPATH
BBPATH .= ":${LAYERDIR}"

# We have recipes-* directories, add to BBFILES
BBFILES += "${LAYERDIR}/recipes-*/*/*.bb \
            ${LAYERDIR}/recipes-*/*/*.bbappend"

BBFILE_COLLECTIONS += "meta-mteaching-mongoose"
BBFILE_PATTERN_meta-mteaching-mongoose = "^${LAYERDIR}/"
BBFILE_PRIORITY_meta-mteaching-mongoose = "6"

LAYERDEPENDS_meta-mteaching-mongoose = "core"
LAYERSERIES_COMPAT_meta-mteaching-mongoose = "kirkstone"
```
